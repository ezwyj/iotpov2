#include <Adafruit_DotStar.h>
#include <ESP8266WiFi.h>
#include <PubSubClient.h>
#include <SPI.h> 



#define MaxStripNum 20
#define switchPin 14

const char* ssid = "ChinaNetuPTU";//"free";
const char* password = "h5rcuvdw";//"133133133";
const char* mqtt_server = "120.76.147.152";

uint32_t contentA[100][MaxStripNum]={ 0xffffff, 0xffffff, 0xffffff, 0xffffff, 0xffffff, 0xffffff, 0xffffff, 0xffffff, 0xffffff, 0xffffff, 0xffffff, 0xffffff, 0xffffff,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 0xffffff, 0xffffff };


int sleepTime = 10;
uint64_t workTime = 0;
boolean workState = false;

int toInt(byte* payload, int length)
{
	int i;
	char val[10];
	for (i = 0; i < length; i++)
		val[i] = payload[i];
	val[i] = '\0';

	return atoi(val);
}
void setup_wifi() {

	delay(10);
	// We start by connecting to a WiFi network
	Serial.println();
	Serial.print(F("Connecting to "));
	Serial.println(ssid);
	WiFi.begin(ssid, password);
	while (WiFi.status() != WL_CONNECTED) {
		delay(500);
		Serial.print(".");
	}

	Serial.println("");
	Serial.println("WiFi connected");
	Serial.println("IP address: ");
	Serial.println(WiFi.localIP());
}
Adafruit_DotStar strip = Adafruit_DotStar(MaxStripNum, 4, 5, DOTSTAR_BRG);
//APA102<4, 5> strip;
WiFiClient espClient;

void callback(char *topic, byte* payload, unsigned int length) {
	Serial.print("Message arrived [");
	Serial.print(topic);
	Serial.print("] ");
	for (int i = 0; i<length; i++) {
		Serial.print((char)payload[i]);
	}
	Serial.println();
	String sTopic = topic;

	if (sTopic == "WorkState")
	{

		int w = toInt(payload, 1);
		if (w == 1)
		{

			workState = true;
		}
		else
		{
			workState = false;
		}

	}
	if (sTopic == "Sleep")
	{
		int s = toInt(payload, 3);
		sleepTime = s;

	}
	if (sTopic == "Content")
	{

		String readRString;
		readRString = readRString + (char)payload[0];
		readRString = readRString + (char)payload[1];//+ (char)payload[2];
		readRString = readRString + (char)payload[2];

		int x = readRString.toInt();
		Serial.println(x);

		for (int i = 0; i<(length - 3) / 6; i++){
			char color[6];
			color[0] = payload[i * 6 + 3];
			color[1] = payload[i * 6 + 4];
			color[2] = payload[i * 6 + 5];
			color[3] = payload[i * 6 + 6];
			color[4] = payload[i * 6 + 7];
			color[5] = payload[i * 6 + 8];
			uint32_t c = strtoul(color, 0, 16);
			contentA[x][i] = c;
		}
	}
}
PubSubClient client(mqtt_server, 1883, callback, espClient);
void reconnect() {
	// Loop until we're reconnected
	while (!client.connected()) {
		Serial.print("Attempting MQTT connection...");
		// Attempt to connect
		if (client.connect("arduinoClient", "iotpov_chengdu/test0001", "Khb78JCWUy2Lqj3miH8bSR45WbC32qM577rHsuDjbYg=")) {
			Serial.println("connected");
			client.subscribe("Content");
			client.subscribe("Sleep");
			client.subscribe("WorkState");
			client.subscribe("WorkTime");
		}
		else {
			Serial.print("failed, rc=");
			Serial.print(client.state());
			Serial.println(" try again in 5 seconds");
			delay(5000);
		}
	}
}

void setup() {

	Serial.begin(9600);
	setup_wifi();
	strip.setBrightness(15);
	strip.begin(); // Initialize pins for output
	strip.show();  // Turn all LEDs off ASAP
	pinMode(switchPin, INPUT);

	attachInterrupt(switchPin, initLocation, CHANGE);
}
int y;
int a;
long lastShowTime;
void initLocation(){
	y = 0;
}
long lasttime;
void loop() {



	//for (int x = location; x < 90; x++){


	for (a = 0; a <= 19; a++){
		strip.setPixelColor(a, contentA[y][a]);
	}
	strip.show();

	if (y >= 100){
		y = 0;
		strip.clear();
	}
	else
	{
		y++;
		delay(1);
		strip.clear();
	}
	// delay(200);

	//Serial.println(y);
	//
	//}

	if (!client.connected()) {
		reconnect();
	}
	client.loop();


}


